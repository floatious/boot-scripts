## rock5b.its
```
/dts-v1/;

/ {
	description = "Rock 5B FIT Image";
	#address-cells = <1>;

	images {
		kernel {
			description = "Kernel";
			data = /incbin/("Image.gz");
			type = "kernel";
			arch = "arm64";
			os = "linux";
			compression = "gzip";
			load = <0x0a200000>;
			entry = <0x0a200000>;
			hash {
				algo = "sha256";
			};
		};
		fdt {
			description = "Device Tree";
			data = /incbin/("rk3588-rock-5b.dtb");
			type = "flat_dt";
			arch = "arm64";
			compression = "none";
			load = <0x0e000000>;
			entry = <0x0e000000>;
			hash {
				algo = "sha256";
			};
		};
		fdt-2 {
			data = /incbin/("rk3588-rock-5b-pcie-ep.dtbo");
			type = "flat_dt";
			arch = "arm64";
			compression = "none";
			load = <0x0e100000>;
			entry = <0x0e100000>;
			hash {
				algo = "sha256";
			};
		};
		fdt-3 {
			data = /incbin/("rk3588-rock-5b-pcie-srns.dtbo");
			type = "flat_dt";
			arch = "arm64";
			compression = "none";
			load = <0x0e100000>;
			entry = <0x0e100000>;
			hash {
				algo = "sha256";
			};
		};
	};

	configurations {
		default = "standard";
		standard {
			description = "Standard Boot";
			kernel = "kernel";
			fdt = "fdt";
			hash {
				algo = "sha256";
			};
		};
		pcie-ep {
			description = "PCIe EP SRNS";
			kernel = "kernel";
			fdt = "fdt", "fdt-2";
			hash {
				algo = "sha256";
			};
		};
		pcie-rc {
			description = "PCIe RC SRNS";
			kernel = "kernel";
			fdt = "fdt", "fdt-3";
			hash {
				algo = "sha256";
			};
		};
	};
};
```
